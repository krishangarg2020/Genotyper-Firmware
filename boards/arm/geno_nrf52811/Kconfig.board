## boards/arm/geno_nrf52811/Kconfig.defconfig
```kconfig
if BOARD_GENO_NRF52811

config BOARD
	default "geno_nrf52811"

config BT_CTLR
	default BT

endif # BOARD_GENO_NRF52811
```

## boards/arm/geno_stm32f429/Kconfig.board
```kconfig
# NUCLEO-144 F429ZI  board configuration

# Copyright (c) 2017 Linaro Limited
# SPDX-License-Identifier: Apache-2.0

config BOARD_GENO_STM32F429
	bool "Genotyper board based on NUCLEO-144 F429ZI Development Board"
	depends on SOC_STM32F429XX
```

## boards/arm/geno_stm32f429/Kconfig.defconfig
```kconfig
# GENOTYOPER board configuration based NUCLEO-144 F429ZI

# Copyright (c) 2021 Technoculture Research
# All rights reserved

if BOARD_GENO_STM32F429

config BOARD
	default "geno_stm32f429"

if NETWORKING

config NET_L2_ETHERNET
	default y

endif # NETWORKING

endif # BOARD_GENO_STM32F429
```

## boards/arm/genotyper_nrf52811/Kconfig.board
```kconfig
# GENOTYPER NRF52811 board configuration

config BOARD_GENOTYPER_NRF52811
	bool "GENOTYPER NRF52811"
	depends on SOC_NRF52811_QFAA
```

## boards/arm/genotyper_nrf52811/Kconfig.defconfig
```kconfig
# nRF52840 DK NRF52811 board configuration

# Copyright (c) 2019 Nordic Semiconductor ASA
# SPDX-License-Identifier: Apache-2.0

if BOARD_GENOTYPER_NRF52811

config BOARD
	default "genotyper_nrf52811"

config BT_CTLR
	default BT

endif # BOARD_GENOTYPER_NRF52811
```

## build/Kconfig/Kconfig.modules
```kconfig
menu "CANopenNode (E:\zephyr_workspace\modules\lib\canopennode)"
osource "$(ZEPHYR_CANOPENNODE_KCONFIG)"
config ZEPHYR_CANOPENNODE_MODULE
	bool
	default y
endmenu
menu "hal_nordic (E:\zephyr_workspace\modules\hal\nordic)"
osource "$(ZEPHYR_HAL_NORDIC_KCONFIG)"
config ZEPHYR_HAL_NORDIC_MODULE
	bool
	default y
endmenu
menu "hal_nxp (E:\zephyr_workspace\modules\hal\nxp)"
osource "$(ZEPHYR_HAL_NXP_KCONFIG)"
config ZEPHYR_HAL_NXP_MODULE
	bool
	default y
endmenu
menu "loramac-node (E:\zephyr_workspace\modules\lib\loramac-node)"
osource "$(ZEPHYR_LORAMAC_NODE_KCONFIG)"
config ZEPHYR_LORAMAC_NODE_MODULE
	bool
	default y
endmenu
menu "lz4 (E:\zephyr_workspace\modules\lib\lz4)"
osource "$(ZEPHYR_LZ4_KCONFIG)"
config ZEPHYR_LZ4_MODULE
	bool
	default y
endmenu
menu "mbedtls (E:\zephyr_workspace\modules\crypto\mbedtls)"
osource "$(ZEPHYR_MBEDTLS_KCONFIG)"
config ZEPHYR_MBEDTLS_MODULE
	bool
	default y
endmenu
menu "nanopb (E:\zephyr_workspace\modules\lib\nanopb)"
osource "$(ZEPHYR_NANOPB_KCONFIG)"
config ZEPHYR_NANOPB_MODULE
	bool
	default y
endmenu
menu "sof (E:\zephyr_workspace\modules\audio\sof)"
osource "E:/zephyr_workspace/modules/audio/sof/zephyr/Kconfig"
config ZEPHYR_SOF_MODULE
	bool
	default y
endmenu
menu "tflite-micro (E:\zephyr_workspace\modules\lib\tflite-micro)"
osource "$(ZEPHYR_TFLITE_MICRO_KCONFIG)"
config ZEPHYR_TFLITE_MICRO_MODULE
	bool
	default y
endmenu
menu "TraceRecorder (E:\zephyr_workspace\modules\debug\TraceRecorder)"
osource "E:/zephyr_workspace/modules/debug/TraceRecorder/kernelports/Zephyr/Kconfig"
config ZEPHYR_TRACERECORDER_MODULE
	bool
	default y
endmenu
menu "trusted-firmware-m (E:\zephyr_workspace\modules\tee\tfm)"
osource "$(ZEPHYR_TRUSTED_FIRMWARE_M_KCONFIG)"
config ZEPHYR_TRUSTED_FIRMWARE_M_MODULE
	bool
	default y
endmenu
```
