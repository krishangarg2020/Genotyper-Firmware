VERSION "GENOTYPER VENDING 1.0"

NS_ :

BS_:

BU_: DBG EXTRACTOR DETECTOR CHOREOGRAPHER

BO_ 100 DETECTOR_HEARTBEAT: 1 DETECTOR
 SG_ DETECTOR_HEARTBEAT_cmd : 0|8@1+ (1,0) [0|0] "" CHOREOGRAPHER

CM_ BU_ EXTRACTOR "The robot responsible for DNA extraction";
CM_ BU_ DETECTOR "The robot responsible for molecular detection";
CM_ BU_ CHOREOGRAPHER "The node responsible for task management";
CM_ BO_ 100 "Sync message used to synchronize the controllers";
