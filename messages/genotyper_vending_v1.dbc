VERSION "GENOTYPER VENDING 1.0"

NS_ :

BS_:

BU_: Choreographer Orchestrator Centrifuge_2 Centrifuge_1 Extractor_3 Extractor_2 Extractor_1 mPCR_2 mPCR_1
VAL_TABLE_ extractor_cmd 3 "FreeUpChip" 2 "TakeChip" 1 "ForceStop" 0 "DoNothing" ;
VAL_TABLE_ extractor_status 3 "Error" 2 "Complete" 1 "In progress" 0 "Idle" ;
VAL_TABLE_ pcr_status 3 "Error" 2 "Complete" 1 "In progress" 0 "Idle" ;
VAL_TABLE_ pcr_cmd 3 "ProvideSwab" 2 "TakeSwab" 1 "ForceStop" 0 "DoNothing" ;

BO_ 3 extractor_cmd: 8 Choreographer
 SG_ extractor_cmd : 0|3@1+ (1,0) [0|7] ""  Extractor_1,Extractor_2,Extractor_3

BO_ 2 extractor_status: 8 Extractor_3
 SG_ extractor_status : 5|3@1+ (1,0) [0|7] ""  Choreographer
 SG_ extractor_progress : 0|5@1+ (5,0) [0|100] "%"  Choreographer

BO_ 1 pcr_cmd: 8 Choreographer
 SG_ pcr_cmd : 0|2@1+ (1,0) [0|7] ""  Centrifuge_2,Centrifuge_1,mPCR_2,mPCR_1

BO_ 0 pcr_status: 8 mPCR_1
 SG_ pcr_status : 5|3@1+ (1,0) [0|7] ""  Choreographer
 SG_ pcr_progress : 0|5@1+ (5,0) [0|100] "%"  Choreographer

BO_TX_BU_ 2 : Extractor_1,Extractor_2,Extractor_3;
BO_TX_BU_ 0 : Centrifuge_1,Centrifuge_2,mPCR_2,mPCR_1;

CM_ BU_ Orchestrator "Gantry liquid handling robot";
CM_ BU_ Centrifuge_2 "Centrifugal DNA amplification and detection system";
CM_ BU_ Centrifuge_1 "Centrifugal DNA amplification and detection system";
CM_ BU_ Extractor_3 "DNA extraction device";
CM_ BU_ Extractor_2 "DNA extraction device";
CM_ BU_ Extractor_1 "DNA extraction device";
CM_ BU_ mPCR_2 "Mechanical PCR device";
CM_ BU_ mPCR_1 "Mechanical PCR device";
BA_DEF_  "BusType" STRING ;
BA_DEF_DEF_  "BusType" "CAN";
VAL_ 3 extractor_cmd 3 "FreeUpChip" 2 "TakeChip" 1 "ForceStop" 0 "DoNothing" ;
VAL_ 2 extractor_status 3 "Error" 2 "Complete" 1 "In progress" 0 "Idle" ;
VAL_ 1 pcr_cmd 3 "ProvideSwab" 2 "TakeSwab" 1 "ForceStop" 0 "DoNothing" ;
VAL_ 0 pcr_status 3 "Error" 2 "Complete" 1 "In progress" 0 "Idle" ;
